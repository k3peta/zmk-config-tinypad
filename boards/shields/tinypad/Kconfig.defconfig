## boards/shields/tinypad/Kconfig.defconfig
```kconfig
if SHIELD_TINYPAD

    config ZMK_KEYBOARD_NAME
        default "TinyPad"

    config ZMK_BLE
        default y

    config INPUT
        default y

    config ZMK_POINTING
        default y

    config SPI
        default y

    config I2C
        default y

config RGBLED_WIDGET_BATTERY_LEVEL_HIGH
    default 30

config RGBLED_WIDGET_BATTERY_LEVEL_CRITICAL
    default 10

endif
```

## config/west.yml
```yaml
manifest:
  remotes:
    - name: zmkfirmware
      url-base: https://github.com/zmkfirmware
    - name: k3peta
      url-base: https://github.com/k3peta
    - name: AYM1607
      url-base: https://github.com/AYM1607
    - name: caksoylar
      url-base: https://github.com/caksoylar

  projects:
    - name: zmk
      remote: zmkfirmware
      revision: v0.3.0
      import: app/west.yml

    - name: zmk-driver-azoteq-iqs5xx
      remote: AYM1607
      revision: main

    - name: zmk-rgbled-widget
      remote: caksoylar
      revision: main

  self:
    path: config
```
